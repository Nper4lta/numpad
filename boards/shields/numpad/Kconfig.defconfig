## boards/shields/numpad/Kconfig.defconfig
```kconfig
# 
# Kconfig shield
# 
# Created: 2025-Sep-13 13:46
# 
# Edited: 2025-Sep-13 14:39

if SHIELD_NUMPAD

config ZMK_KEYBOARD_NAME
    default "Numpad"

endif
```
